#include <Arduino.h>
#include "Antirrebotes.h"

const int16_t ABP[1250] PROGMEM = {-106,	-103,	-96,	-83,	-64,	-42,	-19,	5,	29,	51,	69,	82,	89,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	-64,
};

const uint8_t Arritmia[2580] PROGMEM = {194,	192,	192,	196,	195,	193,	194,	198,	197,	198,	199,	201,	202,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	190,
};

const int8_t ECG[1250] PROGMEM = {19,	19,	22,	20,	18,	13,	10,	5,	1,	-1,	-3,	-4,	-4,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	-1,
};

Antirrebotes botonAntirrebotespin3(3); // Crea una instancia de la clase Antirrebotes para el pin 2
Antirrebotes botonAntirrebotespin4(4);
Antirrebotes botonAntirrebotespin5(5);


void setup(){
  Serial.begin(9600);
  Serial.println(0);
}

void loop() {
  int16_t currentIndex = 0;
  bool exitLoop = false;

  while (!exitLoop) {
    if (botonAntirrebotespin3.estadoBoton()) {
      Serial.println("A");
      while (currentIndex < 1250 && !exitLoop) {
        int8_t value = pgm_read_byte_near(ABP + currentIndex);
        Serial.println(value); // Envía el valor como un número entero
        delay(1);
        currentIndex = currentIndex + 8;

        // Verificar si se presionó otro botón para salir del bucle
        exitLoop = botonAntirrebotespin4.estadoBoton() || botonAntirrebotespin5.estadoBoton();
        delay(90);
      }
    }

    if (botonAntirrebotespin4.estadoBoton()) {
      Serial.println("B");
      while (currentIndex < 2570 && !exitLoop) {
        int8_t value = pgm_read_byte_near(Arritmia + currentIndex);
        Serial.println(value); // Envía el valor como un número entero
        delay(1);
        currentIndex = currentIndex + 8;

        // Verificar si se presionó otro botón para salir del bucle
        exitLoop = botonAntirrebotespin3.estadoBoton() || botonAntirrebotespin5.estadoBoton();
        delay(90);
      }
    }

    if (botonAntirrebotespin5.estadoBoton()) {
      Serial.println("C");
      while (currentIndex < 1250 && !exitLoop) {
        int8_t value = pgm_read_byte_near(ECG + currentIndex);
        Serial.println(value); // Envía el valor como un número entero
        delay(1);
        currentIndex = currentIndex + 8;

        // Verificar si se presionó otro botón para salir del bucle
        exitLoop = botonAntirrebotespin3.estadoBoton() || botonAntirrebotespin4.estadoBoton();
        delay(90);
      }
    }
  }
}
